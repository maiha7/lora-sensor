/**************************************************
 * Copyright (c) 
 * All rights reserved.
 * 
 * 文件名称：Crc8.c
 * 文件标识：
 * 摘    要：Crc8校验
 * 
 * 当前版本：V1.0.0
 * 作    者：yjd
 * 完成日期：2015-08-11
**************************************************/
//#include <includes.h>
#include "stm8l15x.h"
#include "Crc8.h"

//求和算法，超过2位的数字，取低字节数值
uint8_t calc_check_sum8(void *pdata, uint8_t len)
{
	uint8_t *data = (uint8_t*)pdata; //指针类型转换
	uint8_t sum = 0; //函数返回值
	uint8_t i = 0; //计算校验和
	for(; i < len; i++)
	{
		sum += data[i];
	}
	return sum;
}

// 计算crc8(x8+x2+x+1)
uint8_t calc_crc8_x8_x2_x_1(uint8_t code, void *buf, uint8_t len)
{
	const static uint8_t crc_table[256] =
	{
		0x00,0x91,0xE3,0x72,0x07,0x96,0xE4,0x75,
		0x0E,0x9F,0xED,0x7C,0x09,0x98,0xEA,0x7B,
		0x1C,0x8D,0xFF,0x6E,0x1B,0x8A,0xF8,0x69,
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		0xBA,0x2B,0x59,0xC8,0xBD,0x2C,0x5E,0xCF
	};
	uint8_t *p = (uint8_t*)buf;
	uint8_t i = 0;
	for(; i < len; i++)
	{
		code = crc_table[code^p[i]];
	}
	return code;
}


//查表法
unsigned char crc_array[256] = {
    0x00, 0x5e, 0xbc, 0xe2, 0x61, 0x3f, 0xdd, 0x83,
    0xc2, 0x9c, 0x7e, 0x20, 0xa3, 0xfd, 0x1f, 0x41,
    0x9d, 0xc3, 0x21, 0x7f, 0xfc, 0xa2, 0x40, 0x1e,
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    0xb6, 0xe8, 0x0a, 0x54, 0xd7, 0x89, 0x6b, 0x35,
    };
unsigned char CRC8_Table(unsigned char *p, char counter)
{
   unsigned char crc8 = 0;
   for( ; counter > 0; counter--)
   
   {
       crc8 = crc_array[crc8^*p]; //查表得到CRC码
       p++;
   }
   return crc8;
}

//计算法
unsigned char  calcrc_1byte(unsigned char  abyte) 
{ 
 unsigned char  i,crc_1byte;  
 crc_1byte=0;                //设定crc_1byte初值为0
 for(i = 0; i < 8; i++) 
    { 
  if(((crc_1byte^abyte)&0x01)) 
  { 
   crc_1byte^=0x18;  
   crc_1byte>>=1; 
   crc_1byte|=0x80; 
  }       
  else  
   crc_1byte>>=1;
  abyte>>=1;       
 }
 return crc_1byte;
}
unsigned char  calcrc_bytes(unsigned char  *p,unsigned char  len)
{
 unsigned char  crc=0;
 
 while(len--) //len为总共要校验的字节数
 {
  crc=calcrc_1byte(crc^*p++);
 }
 return crc;  //若最终返回的crc为0，则数据传输正确
}
 

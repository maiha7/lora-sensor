/**************************************************
 * Copyright (c) 
 * All rights reserved.
 * 
 * 文件名称：led.c
 * 文件标识：
 * 摘    要：LED驱动和系统时钟初始化
 * 
 * 当前版本：V1.0.0
 * 作    者：yjd
 * 完成日期：2017-03-23
**************************************************/

#include "led.h"
#include "exti.h"
#include "stm8l15x.h"
#include "stdio.h"

//u8 chipID[12];
//char devID_str[50];


///*******************************************************************************
// * 名称: void getchipID(u8 *chipID)
// * 功能: 得到芯片ID
// * 形参: 无
// * 返回: 无
// * 说明: 96位唯一ID
// ******************************************************************************/
//void GetchipID(u8 *chipID)
//{
//  chipID[0] = *(__IO u8 *)(0X4926); 
//  chipID[1] = *(__IO u8 *)(0X4927); 
//  chipID[2] = *(__IO u8 *)(0X4928);
//  chipID[3] = *(__IO u8 *)(0X4929);
//  chipID[4] = *(__IO u8 *)(0X492A); 
//  chipID[5] = *(__IO u8 *)(0X492B); 
//  chipID[6] = *(__IO u8 *)(0X492C);
//  chipID[7] = *(__IO u8 *)(0X492D); 
//  chipID[8] = *(__IO u8 *)(0X492E); 
//  chipID[9] = *(__IO u8 *)(0X492F);
//  chipID[10] = *(__IO u8 *)(0X4930); 
//  chipID[11] = *(__IO u8 *)(0X4931); 
//  sprintf(devID_str,"TEST=01,ID=%02X%02X%02X%02X%02X%02X%02X%02X%02X%02X%02X%02X",chipID[0],chipID[1],chipID[2],
//          chipID[3],chipID[4],chipID[5],chipID[6],chipID[7],chipID[8],chipID[9],chipID[10],chipID[11]);
//}

/*******************************************************************************
 * 名称: void LED_Init(void)
 * 功能: LED管脚初始化
 * 形参: 无
 * 返回: 无
 * 说明: 无 
 ******************************************************************************/
void LED_Init(void)
{
  LED_OUT;
  LED_LOW;
}
/*******************************************************************************
 * 名称: void led_toggle(void)
 * 功能: led灯变换开关状态
 * 形参: 无
 * 返回: 无
 * 说明: 无 
 ******************************************************************************/
void Led_Toggle(void)
{
  GPIO_ToggleBits(LED_PORT, LED_PIN);
}

/*******************************************************************************
 * 名称: void led_on (void)
 * 功能: led灯变换开关状态
 * 形参: 无
 * 返回: 无
 * 说明: 无 
 ******************************************************************************/
void Led_On(void)
{
  GPIO_SetBits(LED_PORT, LED_PIN);
}
/*******************************************************************************
 * 名称: void led_off(void)
 * 功能: led灯关
 * 形参: 无
 * 返回: 无
 * 说明: 无 
 ******************************************************************************/
void Led_Off(void)
{
  GPIO_ResetBits(LED_PORT, LED_PIN);
}
/**************************************************
 * 函数名称：void delay_us(u16 num)
 * 函数介绍：微秒延时          
 * 输入参数：
 * 输出参数：
 * 返回值  ：
 **************************************************/
void delay_us(u16 num)
{
  while(num--);
}
//void delay_us(u16 num)
//{
//  TIM4_Cmd(ENABLE);
//  TIM4_SetCounter(0); 
//  while(num--)
//  {
//    while (RESET == TIM4_GetFlagStatus(TIM4_FLAG_Update));
//    TIM4_ClearFlag(TIM4_FLAG_Update);
//  }
//  TIM4_Cmd(DISABLE);
//}
//void delay_us(u16 nus)
//{  
//    __asm(
//    "PUSH A          \n"  //1T,压栈
//    "DELAY_XUS:      \n"   
//    "LD A,1     \n"   //1T,fac_us加载到累加器A
//    "DELAY_US_1:     \n"  
//    "NOP             \n"  //1T,nop延时
//    "DEC A           \n"  //1T,A--
//    "JRNE DELAY_US_1 \n"   //不等于0,则跳转(2T)到DELAY_US_1继续执行,若等于0,则不跳转(1T).
//    "NOP             \n"  //1T,nop延时
//    "DECW X          \n"  //1T,x--
//    "JRNE DELAY_XUS  \n"    //不等于0,则跳转(2T)到DELAY_XUS继续执行,若等于0,则不跳转(1T).
//    "POP A           \n"  //1T,出栈
//    ); 
//}
/**************************************************
 * 函数名称：void delay_ms(u16 num)
 * 函数介绍：毫秒延时     
 * 输入参数：
 * 输出参数：
 * 返回值  ：
 **************************************************/
void delay_ms(u16 num)
{
  u16 i = 0;
  while(num--)
  {
     for (i = 0; i < 1300; i++);
  }
}
/**************************************************
 * 函数名称：void delay_s(u16 num)
 * 函数介绍：秒延时     
 * 输入参数：
 * 输出参数：
 * 返回值  ：
 **************************************************/
void delay_s(u16 num)
{
  u16 i = 0;
  for (i = 0; i < num; i++)
  {
    delay_ms(1000);
  }
}
